## arch/arm/mach-msm/Kconfig
```kconfig
if ARCH_MSM

choice
	prompt "Qualcomm MSM SoC Type"
	default ARCH_MSM7X00A
	depends on ARCH_MSM

config ARCH_MSM7X00A
	bool "MSM7x00A / MSM7x01A"
	select ARCH_MSM_ARM11
	select CPU_V6
	select GPIO_MSM_V1
	select MACH_TROUT if !MACH_HALIBUT
	select MSM_PROC_COMM
	select MSM_SMD
	select CLKSRC_QCOM
	select MSM_SMD_PKG3

config ARCH_MSM7X30
	bool "MSM7x30"
	select ARCH_MSM_SCORPION
	select CPU_V7
	select GPIO_MSM_V1
	select MSM_PROC_COMM
	select MSM_SMD
	select CLKSRC_QCOM
	select MSM_VIC
	select MSM_DALRPC
	select MSM_SPM_V1
	select ARM_HAS_SG_CHAIN
	select HAS_MSM_DEBUG_UART_PHYS
	select MSM_REMOTE_SPINLOCK_DEKKERS
	select ARCH_HAS_HOLES_MEMORYMODEL
	select ARCH_HAS_CPUFREQ
	select GENERIC_GPIO
	select GENERIC_TIME
	select GENERIC_ALLOCATOR
	select HAVE_SCHED_CLOCK
	select NEED_MACH_GPIO_H
	select NEED_MACH_IO_H

config ARCH_QSD8X50
	bool "QSD8X50"
	select ARCH_MSM_SCORPION
	select CPU_V7
	select GPIO_MSM_V1
	select MACH_QSD8X50_SURF if !MACH_QSD8X50A_ST1_5
	select MSM_GPIOMUX
	select MSM_PROC_COMM
	select MSM_SMD
	select CLKSRC_QCOM
	select MSM_VIC

endchoice

config MSM_SOC_REV_A
	bool

config  ARCH_MSM_ARM11
	bool

config  ARCH_MSM_SCORPION
	bool

config  MSM_VIC
	bool

config MSM_REMOTE_SPINLOCK_DEKKERS
	bool

config MSM_REMOTE_SPINLOCK_SWP
	bool

config MSM_REMOTE_SPINLOCK_SFPB
	bool

config PERFLOCK
	depends on CPU_FREQ
	depends on ARCH_MSM8960 || ARCH_MSM8X60 || ARCH_QSD8X50 || ARCH_MSM7X30 || ARCH_MSM7X00A
	default n
	bool "HTC Performance Lock"

config PERFLOCK_BOOT_LOCK
	depends on PERFLOCK
	depends on ARCH_MSM8960 || ARCH_MSM8X60 || ARCH_QSD8X50 || ARCH_MSM7X30 || ARCH_MSM7X00A
	default n
	bool "Boot Time Performance Lock"

config PERFLOCK_SCREEN_POLICY
	depends on PERFLOCK
	depends on ARCH_MSM8960 || ARCH_MSM8X60 || ARCH_QSD8X50 || ARCH_MSM7X00A
	default n
	bool "Change Cpufreq Policy while Screen ON/OFF"

config PERFLOCK_SCREEN_ON_MIN
	depends on PERFLOCK_SCREEN_POLICY
	int "Minimum speed while screen on"
	default MSM_CPU_FREQ_ONDEMAND_MIN

config PERFLOCK_SCREEN_ON_MAX
	depends on PERFLOCK_SCREEN_POLICY
	int "Maximum speed while screen on"
	default MSM_CPU_FREQ_ONDEMAND_MAX

config PERFLOCK_SCREEN_OFF_MIN
	depends on PERFLOCK_SCREEN_POLICY
	int "Minimum speed while screen off"
	default MSM_CPU_FREQ_ONDEMAND_MIN

config PERFLOCK_SCREEN_OFF_MAX
	depends on PERFLOCK_SCREEN_POLICY
	int "Maximum speed while screen off"
	default MSM_CPU_FREQ_ONDEMAND_MIN

menu "Qualcomm MSM Board Type"
	depends on ARCH_MSM

config MACH_HALIBUT
	depends on ARCH_MSM
	depends on ARCH_MSM7X00A
	bool "Halibut Board (QCT SURF7201A)"
	help
	  Support for the Qualcomm SURF7201A eval board.

config MACH_TROUT
	depends on ARCH_MSM
	depends on ARCH_MSM7X00A
	bool "HTC Dream (aka trout)"
	help
	  Support for the HTC Dream, T-Mobile G1, Android ADP1 devices.

config MACH_MSM7X30_SURF
	depends on ARCH_MSM7X30
	bool "MSM7x30 SURF"
	help
	  Support for the Qualcomm MSM7x30 SURF eval board.

config ARCH_MSM7X30_SMD
	bool "Support QCT 7X30 SMD function"
	default n
	help
	  For QCT SMD function, we need 7x30 rpcrouter and smd drivers.

config MACH_SPADE
	depends on ARCH_MSM7X30
	default n
	bool "Spade"
	select CLKDEV_LOOKUP
	help
	  Support for the Qualcomm Spade board.

config MACH_QSD8X50_SURF
	depends on ARCH_QSD8X50
	bool "QSD8x50 SURF"
	help
	  Support for the Qualcomm QSD8x50 SURF eval board.

config MACH_QSD8X50A_ST1_5
	depends on ARCH_QSD8X50
	bool "QSD8x50A ST1.5"
	select MSM_SOC_REV_A
	help
	  Support for the Qualcomm ST1.5.

endmenu

config MSM_IOMMU
	bool "MSM IOMMU Support"
	depends on ARCH_MSM8X60 || ARCH_MSM8960
	select IOMMU_API
	default n
	help
	  Support for the IOMMUs found on certain Qualcomm SOCs.
	  These IOMMUs allow virtualization of the address space used by most
	  cores within the multimedia subsystem.

	  If unsure, say N here.

config HAS_MSM_DEBUG_UART_PHYS
	bool

config MSM_DEBUG_UART
	int
	default 1 if MSM_DEBUG_UART1
	default 2 if MSM_DEBUG_UART2
	default 3 if MSM_DEBUG_UART3
	default 8 if MSM_DEBUG_UART8
	default 11 if MSM_DEBUG_UART11

if HAS_MSM_DEBUG_UART_PHYS
choice
	prompt "Debug UART"

	default MSM_DEBUG_UART_NONE

	config MSM_DEBUG_UART_NONE
		bool "None"

	config MSM_DEBUG_UART1
		bool "UART1"

	config MSM_DEBUG_UART2
		bool "UART2"

	config MSM_DEBUG_UART3
		bool "UART3"

	config MSM_DEBUG_UART8
		bool "UART8"

	config MSM_DEBUG_UART11
		bool "UART11"
endchoice
endif

config MSM_MDP40
	bool
	depends on ARCH_MSM7X30 || ARCH_MSM8X60
	default y

config MSM_STACKED_MEMORY
	bool "Stacked Memory"
	default y
	help
	  This option is used to indicate the presence of on-die stacked
	  memory.  When present this memory bank is used for a high speed
	  shared memory interface.  When not present regular RAM is used.

config PHYS_OFFSET
	hex "Kernel physical start address"
	default "0x80400000" if ARCH_MSM8960
	default "0x00200000" if !MSM_STACKED_MEMORY
	default "0x00000000" if ARCH_QSD8X50 && MSM_SOC_REV_A
	default "0x20000000" if ARCH_QSD8X50
	default "0x48000000" if ARCH_MSM8X60
	default "0x10000000"

config MSM_AMSS_VERSION
	int
	default 6210 if MSM_AMSS_VERSION_6210
	default 6220 if MSM_AMSS_VERSION_6220
	default 6225 if MSM_AMSS_VERSION_6225
	default 6350 if MSM_AMSS_VERSION_6350
	default 6355 if MSM_AMSS_VERSION_6355
	default 1355 if MSM_AMSS_VERSION_1355
	default 4725 if MSM_AMSS_VERSION_4725
	default 4735 if MSM_AMSS_VERSION_4735
	default 4410 if MSM_AMSS_VERSION_4410
	default 3200 if MSM_AMSS_VERSION_3200
	default 1170 if MSM_AMSS_VERSION_1170
	default 1200 if MSM_AMSS_VERSION_1200

choice
	prompt "AMSS modem firmware version"

	default MSM_AMSS_VERSION_6225

	config MSM_AMSS_VERSION_6210
	  bool "6.2.10"

	config MSM_AMSS_VERSION_6220
	  bool "6.2.20"

	config MSM_AMSS_VERSION_6225
	  bool "6.2.20 + New ADSP"

	config MSM_AMSS_VERSION_6350
	  bool "6.3.50"

	config MSM_AMSS_VERSION_6355
	  bool "6.3.55"

	config MSM_AMSS_VERSION_1355
	  bool "1.3.55"

	config MSM_AMSS_VERSION_4725
	  bool "4.7.25"

	config MSM_AMSS_VERSION_4735
	  bool "4.7.25 + SBA 3001"

	config MSM_AMSS_VERSION_4410
	  bool "4.4.10"

	config MSM_AMSS_VERSION_3200
	  bool "3.2.00"

	config MSM_AMSS_VERSION_1170
	  bool "1.1.70"

	config MSM_AMSS_VERSION_1200
	  bool "1.2.00"

endchoice

choice
	prompt "Default Timer"
	default MSM7X00A_USE_GP_TIMER

	config MSM7X00A_USE_GP_TIMER
	  bool "GP Timer"
	help
	  Low resolution timer that allows power collapse from idle.

	config MSM7X00A_USE_DG_TIMER
	  bool "DG Timer"
	help
	  High resolution timer.
endchoice

choice
	prompt "Suspend sleep mode"
	default MSM7X00A_SLEEP_MODE_POWER_COLLAPSE_SUSPEND
	help
	  Allows overriding the sleep mode used. Leave at power
	  collapse suspend unless the arm9 image has problems.

	config MSM7X00A_SLEEP_MODE_POWER_COLLAPSE_SUSPEND
	  bool "Power collapse suspend"
	help
	  Lowest sleep state. Returns through reset vector.

	config MSM7X00A_SLEEP_MODE_POWER_COLLAPSE
	  bool "Power collapse"
	help
	  Sleep state that returns through reset vector.

	config MSM7X00A_SLEEP_MODE_APPS_SLEEP
	  bool "Apps Sleep"

	config MSM7X00A_SLEEP_MODE_RAMP_DOWN_AND_WAIT_FOR_INTERRUPT
	  bool "Ramp down cpu clock and wait for interrupt"

	config MSM7X00A_SLEEP_WAIT_FOR_INTERRUPT
	  bool "Wait for interrupt"
endchoice

config MSM7X00A_SLEEP_MODE
	int
	default 0 if MSM7X00A_SLEEP_MODE_POWER_COLLAPSE_SUSPEND
	default 1 if MSM7X00A_SLEEP_MODE_POWER_COLLAPSE
	default 2 if MSM7X00A_SLEEP_MODE_APPS_SLEEP
	default 3 if MSM7X00A_SLEEP_MODE_RAMP_DOWN_AND_WAIT_FOR_INTERRUPT
	default 4 if MSM7X00A_SLEEP_WAIT_FOR_INTERRUPT

choice
	prompt "Idle sleep mode"
	default MSM7X00A_IDLE_SLEEP_MODE_POWER_COLLAPSE
	help
	  Allows overriding the sleep mode used from idle. Leave at power
	  collapse suspend unless the arm9 image has problems.

	config MSM7X00A_IDLE_SLEEP_MODE_POWER_COLLAPSE_SUSPEND
	  bool "Power collapse suspend"
	help
	  Lowest sleep state. Returns through reset vector.

	config MSM7X00A_IDLE_SLEEP_MODE_POWER_COLLAPSE
	  bool "Power collapse"
	help
	  Sleep state that returns through reset vector.

	config MSM7X00A_IDLE_SLEEP_MODE_APPS_SLEEP
	  bool "Apps Sleep"

	config MSM7X00A_IDLE_SLEEP_MODE_RAMP_DOWN_AND_WAIT_FOR_INTERRUPT
	  bool "Ramp down cpu clock and wait for interrupt"

	config MSM7X00A_IDLE_SLEEP_WAIT_FOR_INTERRUPT
	  bool "Wait for interrupt"
endchoice

config MSM7X00A_IDLE_SLEEP_MODE
	int
	default 0 if MSM7X00A_IDLE_SLEEP_MODE_POWER_COLLAPSE_SUSPEND
	default 1 if MSM7X00A_IDLE_SLEEP_MODE_POWER_COLLAPSE
	default 2 if MSM7X00A_IDLE_SLEEP_MODE_APPS_SLEEP
	default 3 if MSM7X00A_IDLE_SLEEP_MODE_RAMP_DOWN_AND_WAIT_FOR_INTERRUPT
	default 4 if MSM7X00A_IDLE_SLEEP_WAIT_FOR_INTERRUPT

config MSM7X00A_IDLE_SLEEP_MIN_TIME
	int "Minimum idle time before sleep"
	default 20000000
	help
	  Minimum idle time in nanoseconds before entering low power mode.

config MSM7X00A_IDLE_SPIN_TIME
	int "Idle spin time before cpu ramp down"
	default 80000
	help
	  Spin time in nanoseconds before ramping down cpu clock and entering
	  any low power state.

menuconfig MSM_IDLE_STATS
	bool "Collect idle statistics"
	default y
	help
	  Collect idle statistics and export them in proc/msm_pm_stats.

if MSM_IDLE_STATS

config MSM_IDLE_STATS_FIRST_BUCKET
	int "First bucket time"
	default 62500
	help
	  Upper time limit in nanoseconds of first bucket.

config MSM_IDLE_STATS_BUCKET_SHIFT
	int "Bucket shift"
	default 2

config MSM_IDLE_STATS_BUCKET_COUNT
	int "Bucket count"
	default 10

config MSM_SUSPEND_STATS_FIRST_BUCKET
	int "First bucket time for suspend"
	default 1000000000
	help
	  Upper time limit in nanoseconds of first bucket of the
	  histogram.  This is for collecting statistics on suspend.

endif # MSM_IDLE_STATS

config HTC_HEADSET
	tristate "HTC 2 Wire detection driver"
	default n
	help
	  Provides support for detecting HTC 2 wire devices, such as wired
	  headset, on the trout platform. Can be used with the msm serial
	  debugger, but not with serial console.

config HTC_BATTCHG
	depends on MSM_ONCRPCROUTER && POWER_SUPPLY
	default n
	bool "HTC battery / charger driver"

config HTC_BATTCHG_SMEM
	depends on HTC_BATTCHG
	default n
	bool "Read Battery Info via SMEM"

config MSM_FIQ_SUPPORT
	default y
	bool "Enable installation of an FIQ handler."

config MSM_SERIAL_DEBUGGER
	select MSM_FIQ_SUPPORT
	select KERNEL_DEBUGGER_CORE
	default n
	bool "FIQ Mode Serial Debugger"
	help
	  The FIQ serial debugger can accept commands even when the
	  kernel is unresponsive due to being stuck with interrupts
	  disabled.  Depends on the kernel debugger core in drivers/misc.

config MSM_PROC_COMM
	default y
	bool "Proc-Comm RPC Interface"
	help
	  Enables a lightweight communications interface to the
	  baseband processor.

config MSM_SMD
	bool "MSM Shared Memory Driver (SMD)"
	select SERIAL_MSM_SMD
	help
	  Support for the shared memory interface between the apps
	  processor and the baseband processor.  Provides access to
	  the "shared heap", as well as virtual serial channels
	  used to communicate with various services on the baseband
	  processor.

choice
	prompt "MSM Shared memory interface version"
	depends on MSM_SMD
	default MSM_SMD_PKG3 if ARCH_MSM_ARM11
	default MSM_SMD_PKG4 if ARCH_MSM_SCORPION

	config MSM_SMD_PKG3
	bool
	  prompt "Package 3"

	config MSM_SMD_PKG4
	bool
	  prompt "Package 4"
endchoice

config MSM_SMD_DEBUG
	depends on MSM_SMD
	default y
	bool "MSM SMD debug support"
	help
	  Support for debugging the SMD for communication
	  between the ARM9 and ARM11

config MSM_N_WAY_SMD
	depends on (MSM_SMD && !(ARCH_MSM7X00A))
	default y
	bool "MSM N-WAY SMD support"
	help
	  Supports APPS-QDSP SMD communication along with
	  normal APPS-MODEM SMD communication.

config MSM_N_WAY_SMSM
	depends on (MSM_SMD && !(ARCH_MSM7X00A))
	default y
	bool "MSM N-WAY SMSM support"
	help
	  Supports APPS-QDSP SMSM communication along with
	  normal APPS-MODEM SMSM communication.

config MSM_SMD_LOGGING
	depends on MSM_SMD
	default y
	bool "MSM Shared Memory Logger"
	help
	  This option exposes the shared memory logger at /dev/smem_log
	  and a debugfs node named smem_log.

	  If in doubt, say yes.

config MSM_SMD_TTY
	bool "SMD TTY Driver"
	depends on MSM_SMD
	default y
	help
	  Provides TTY interfaces to interact with the modem.

	  If in doubt, say yes.

config MSM_SMD_QMI
	bool "SMD QMI Driver"
	depends on MSM_SMD
	default y
	help
	  Manages network data connections.

	  If in doubt, say yes.

config MSM_ONCRPCROUTER
	depends on MSM_SMD
	default n
	bool "MSM ONCRPC router support"
	help
	  Support for the MSM ONCRPC router for communication between
	  the ARM9 and ARM11

config MSM_ONCRPCROUTER_DEBUG
	depends on MSM_ONCRPCROUTER
	default y
	bool "MSM debug ONCRPC router support"
	help
	  Support for debugging the ONCRPC router for communication
	  between the ARM9 and ARM11

config MSM_RPC_LOOPBACK_XPRT
	depends on MSM_ONCRPCROUTER
	default n
	bool "MSM RPC local routing support"
	help
	  Support for routing RPC messages between APPS clients
	  and APPS servers.  Helps in testing APPS RPC framework.

config MSM_RPCSERVER_TIME_REMOTE
	depends on MSM_ONCRPCROUTER && RTC_HCTOSYS
	default y
	bool "Time remote RPC server"
	help
	  The time remote server receives notification of time bases and
	  reports these events to registered callback functions.

config MSM_RPCSERVER_WATCHDOG
	depends on MSM_ONCRPCROUTER
	default y
	bool "Watchdog RPC server"
	help
	  The dog_keepalive server handles watchdog events.

config MSM_RPC_WATCHDOG
	depends on MSM_ONCRPCROUTER
	default n
	bool "Watchdog RPC client"
	help
	  The dog_keepalive client module.

config MSM_RPC_PING
	depends on MSM_ONCRPCROUTER && DEBUG_FS
	default m
	bool "MSM rpc ping"
	help
	  Implements MSM rpc ping test module.

config MSM_RPC_PROC_COMM_TEST
	depends on DEBUG_FS && MSM_PROC_COMM
	default m
	bool "MSM rpc proc comm test"
	help
	  Implements MSM rpc proc comm test module.

config MSM_RPCSERVER_HANDSET
	depends on MSM_ONCRPCROUTER
	default y
	bool "Handset events RPC server"
	help
	  Support for receiving handset events like headset detect,
	  headset switch and clamshell state.

config MSM_RMT_STORAGE_CLIENT
	depends on (ARCH_MSM && MSM_ONCRPCROUTER)
	default n
	bool "Remote Storage RPC client"
	help
	  Provide RPC mechanism for remote processors to access storage
	  device on apps processor.

config MSM_RMT_STORAGE_CLIENT_STATS
	depends on (MSM_RMT_STORAGE_CLIENT && DEBUG_FS)
	default n
	bool "Remote storage RPC client performance statistics"
	help
	  Collects performance statistics and shows this information
	  through a debugfs file rmt_storage_stats.

config MSM_DALRPC
	bool "DAL RPC support"
	depends on ARCH_MSM_SCORPION
	default y
	help
	  Supports RPC calls to DAL devices on remote processor cores.

config CPU_FREQ_MSM
	bool
	depends on CPU_FREQ && ARCH_MSM
	default y
	help
	  This enables the CPUFreq driver for Qualcomm CPUs.
	  If in doubt, say Y.

if CPU_FREQ_MSM

config MSM_CPU_FREQ_SET_MIN_MAX
	bool "Set Min/Max CPU frequencies."
	default n
	help
	  Allow setting min and max CPU frequencies. Sysfs can be used
	  to override these values.

config MSM_CPU_FREQ_MAX
	int "Max CPU Frequency"
	depends on MSM_CPU_FREQ_SET_MIN_MAX
	default 384000

config MSM_CPU_FREQ_MIN
	int "Min CPU Frequency"
	depends on MSM_CPU_FREQ_SET_MIN_MAX
	default 245760

endif # CPU_FREQ_MSM

if PERFLOCK

config MSM_CPU_FREQ_ONDEMAND_MAX
	int "Max"
	default 384000

config MSM_CPU_FREQ_ONDEMAND_MIN
	int "Min"
	default 245760

endif # PERFLOCK

config ACPUCLOCK_OVERCLOCKING
	bool "Enable support for CPU overclocking"
	default n
	depends on CPU_FREQ && !PERFLOCK
	depends on ARCH_MSM7X30

config MSM_ADSP
	depends on ARCH_MSM7X00A
	tristate "MSM ADSP driver"
	depends on ANDROID_PMEM
	default y
	help
	  Provides access to registers needed by the userspace aDSP library.

choice
	prompt "ADSP RPC version"

	default AMSS_7X25_VERSION_2009

	config AMSS_7X25_VERSION_2009
	  bool "2.0.09"

	config AMSS_7X25_VERSION_2008
	  bool "2.0.08"
endchoice

config MSM7KV2_AUDIO
	bool "MSM7K v2 audio"
	depends on ARCH_MSM7X30
	default y
	help
	  Enables QDSP5V2-based audio drivers for audio playbacks and
	  voice call.

config MSM_ADSP_REPORT_EVENTS
	bool "Report modem events from the DSP"
	default y
	depends on (MSM_ADSP || MSM7KV2_AUDIO || MSM7KV2_1X_AUDIO)
	help
	  Normally, only messages from the aDSP are reported to userspace.
	  With this option, we report events from the aDSP as well.

config WIFI_CONTROL_FUNC
	bool "Enable WiFi control function abstraction"
	help
	  Enables Power/Reset/Carddetect function abstraction

config ARCH_MSM_FLASHLIGHT
	bool "Flashlight Driver"
	depends on ARCH_MSM
	help
	  The flashlight driver is for MSM series.

config ARCH_MSM_FLASHLIGHT_DEATH_RAY
	bool "Enable high-brightness (death ray) mode"
	depends on ARCH_MSM_FLASHLIGHT
	default n
	help
	  Enables a high-brightness mode for the flash LED. Dangerous

config AUDIO_AAC_PLUS
	depends on (MSM_ADSP || MSM7KV2_AUDIO)
	bool "AAC+ Audio"
	default y
	help
	  Provides AAC+ decoding

config AUDIO_ENHANCED_AAC_PLUS
	depends on AUDIO_AAC_PLUS
	bool "Enhanced AAC+ Audio"
	default y
	help
	  Provides Enhanced AAC+ decoding

config SURF_FFA_GPIO_KEYPAD
	bool "MSM SURF/FFA GPIO keypad"
	depends on INPUT_GPIO = "y"
	default y
	help
	  Select if the GPIO keypad is attached.

config MSM_SLEEP_TIME_OVERRIDE
	bool "Allow overriding suspend/sleep time with PM module parameter"
	default y
	help
	  Enable the module parameter sleep_time_override. Specified
	  in units of seconds, it overwrites the normal sleep time of
	  suspend. The feature is required for automated power management
	  testing.

config MSM_MEMORY_LOW_POWER_MODE
	bool "Control the low power modes of memory"
	default n
	help
	  The application processor controls whether memory should enter
	  which low power mode.

choice
	prompt "Default Memory Low Power Mode during Idle"
	depends on MSM_MEMORY_LOW_POWER_MODE
	default MSM_MEMORY_LOW_POWER_MODE_IDLE_ACTIVE
	help
	  Selects the default low power mode of the memory during idle
	  sleep.

	config MSM_MEMORY_LOW_POWER_MODE_IDLE_ACTIVE
	  bool "Memory active"

	config MSM_MEMORY_LOW_POWER_MODE_IDLE_RETENTION
	  bool "Memory in retention"

	config MSM_MEMORY_LOW_POWER_MODE_IDLE_DEEP_POWER_DOWN
	  bool "Memory in deep power down"
endchoice

choice
	prompt "Default Memory Low Power Mode during Suspend"
	depends on MSM_MEMORY_LOW_POWER_MODE
	default MSM_MEMORY_LOW_POWER_MODE_SUSPEND_ACTIVE
	help
	  Selects the default low power mode of the memory during suspend
	  sleep.

	config MSM_MEMORY_LOW_POWER_MODE_SUSPEND_ACTIVE
	  bool "Memory active"

	config MSM_MEMORY_LOW_POWER_MODE_SUSPEND_RETENTION
	  bool "Memory in retention"

	config MSM_MEMORY_LOW_POWER_MODE_SUSPEND_DEEP_POWER_DOWN
	  bool "Memory in deep power down"
endchoice

choice
	prompt "Power management timeout action"
	default MSM_PM_TIMEOUT_HALT
	help
	  Selects the Application Processor's action when Power Management
	  times out waiting for Modem's handshake.

	config MSM_PM_TIMEOUT_HALT
	  bool "Halt the Application Processor"

	config MSM_PM_TIMEOUT_RESET_MODEM
	  bool "Reset the Modem Processor"

	config MSM_PM_TIMEOUT_RESET_CHIP
	  bool "Reset the entire chip"
endchoice

config MSM_IDLE_WAIT_ON_MODEM
	int "Wait for Modem to become ready for idle power collapse"
	default 0
	help
	  If Modem is not ready to handle Application Processor's request
	  for idle power collapse, wait the number of microseconds in case
	  Modem becomes ready soon.

config MICROP_COMMON
	tristate "MICROP COMMON Driver"
	depends on I2C
	help
	  HTC Microp-P support.

config HTC_HEADSET_MGR
	tristate "HTC headset manager driver"
	default n
	help
	  Provides support of HTC headset manager.

config HTC_HEADSET_GPIO
	tristate "HTC GPIO headset detection driver"
	depends on HTC_HEADSET_MGR
	default n
	help
	  Provides support of HTC GPIO headset detection.

config HTC_HEADSET_MICROP
	tristate "HTC Micro-P headset detection driver"
	depends on HTC_HEADSET_MGR && MICROP_COMMON
	default n
	help
	  Provides support of HTC Micro-P headset detection.

config HTC_HEADSET_PMIC
	tristate "HTC PMIC headset detection driver"
	depends on HTC_HEADSET_MGR
	default n
	help
	  Provides support of HTC PMIC headset detection.

config SMD_OFFSET_TCXO_STAT
	depends on MSM_SMD
	hex "SMD offset of total TCXO-off time"
	default 0x0
	help
	  TCXO off time is in tick of sleep clock, 1/32768.

config SMD_OFFSET_NEGATE_CLIENT_STAT
	depends on MSM_SMD
	hex "SMD offset of negate clinet stat"
	default 0x0
	help
	  TCXO shutdown retry conuter and negate tcxoc client counters.

config MSM_SCM
	bool "Secure Channel Manager (SCM) support"
	default n

config IOMMU_API
	bool

config MSM_GPIOMUX
	bool
	help
	  Support for MSM V1 TLMM GPIOMUX architecture.

config MSM_DEBUG_ACROSS_PC
	bool "Debug support across power collapse"
	help
	  Enables debug state to be saved and restored across power collapse.

config MSM_JTAG_V7
	depends on CPU_V7
	default y if DEBUG_KERNEL
	bool "JTAG debug support"
	select MSM_DEBUG_ACROSS_PC
	help
	  Add additional support for JTAG kernel debugging.

config MSM_GSBI9_UART
	bool "Enable GSBI9 UART device"
	default n
	help
	  This enables GSBI9 configured into UART.

config MSM_SHOW_RESUME_IRQ
	bool "Enable logging of interrupts that could have caused resume"
	depends on (ARCH_MSM7X30 || ARCH_MSM8X60 || ARCH_MSM8960)
	default n
	help
	  This option logs wake up interrupts that have triggered just before
	  the resume loop unrolls. Say Y if you want to debug why the system
	  resumed.

config SUPPORT_DQ_BATTERY
	bool "Support DQ battery."
	default n
	help
	  support DQ battery.

config MSM_RPC_VIBRATOR
	bool "RPC based MSM Vibrator Support"
	depends on MSM_ONCRPCROUTER
	help
	  Enable the vibrator support on MSM over RPC. The vibrator
	  is connected on the PMIC. Say Y if you want to enable this
	  feature.

config DEBUG_BY_VIBRATOR
	bool "Debug by Vibrator support"
	depends on MSM_RPC_VIBRATOR
	help
	  Enable the vibrator debug support on MSM over RPC. The vibrator
	  will provide debug_by_vibrator() API for other module to debug use.
	  Say Y if you want to enable this feature.

config MSM_SPM_V1
	bool "Driver support for SPM Version 1"
	help
	  Enables the support for Version 1 of the SPM driver. SPM hardware is
	  used to manage the processor power during sleep. The driver allows
	  configuring SPM to allow different power modes.

config MSM_MULTIMEDIA_USE_ION
	bool "Multimedia support using Ion"
	depends on ION_MSM
	help
	  Enable support for multimedia drivers using Ion for buffer management
	  instead of pmem. Selecting this may also involve userspace
	  dependencies as well.

comment "TI WLAN driver"
config WIFI_CONTROL_FUNC
	bool "Enable WiFi control function abstraction"
	select WIRELESS_EXT
	select WEXT_CORE
	select WEXT_PROC
	select WEXT_PRIV
	default Y
	help
	   Enables Power/Reset/Carddetect function abstraction

config FORCE_FAST_CHARGE
	bool "Force AC charge mode at will"
	default y
	help
	  A simple sysfs interface to force adapters that
	  are detected as USB to charge as AC.

endif

config MMC_MSM_SDC1_SUPPORT
	boolean "Qualcomm SDC1 support"
	depends on MMC_MSM
	default y
	help
	  Select Y to enable Slot 1.

config MMC_MSM_SDC2_SUPPORT
	boolean "Qualcomm SDC2 support"
	depends on MMC_MSM
	default y
	help
	  Select Y to enable Slot 2.

config MMC_MSM_SDC2_8_BIT_SUPPORT
	boolean "Qualcomm SDC2 8bit support"
	depends on MMC_MSM_SDC2_SUPPORT
	default n
	help
	  Select Y to enable 8bit support for Slot 2.

config MMC_MSM_SDC3_SUPPORT
	boolean "Qualcomm SDC3 support"
	depends on MMC_MSM
	default n
	help
	  Select Y to enable Slot 3.

config MMC_MSM_SDC4_SUPPORT
	boolean "Qualcomm SDC4 support"
	depends on MMC_MSM
	default n
	help
	  Select Y to enable Slot 4.
```
